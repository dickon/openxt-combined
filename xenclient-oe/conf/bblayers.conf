## xenclient-oe/conf/bblayers.conf
```bitbake
# LAYER_CONF_VERSION is increased each time build/conf/bblayers.conf
# changes incompatibly
LCONF_VERSION = "4"

BBFILES ?= ""
BBLAYERS ?= " \
  ${TOPDIR}/../../xenclient-oe-extra \
  ${TOPDIR}/../../xenclient-oe/xenclient \
  ${TOPDIR}/repos/openembedded-core/meta \
  ${TOPDIR}/repos/meta-openembedded/meta-xfce \
  ${TOPDIR}/repos/meta-openembedded/meta-oe \
  ${TOPDIR}/repos/meta-openembedded/meta-gnome \
  ${TOPDIR}/repos/meta-java \
  ${TOPDIR}/../../meta-selinux \
  "

 
```
